## firmware/esp32s3/main/Kconfig.projbuild
```kconfig
menu "SAEMS firmware"

config SAEMS_WIFI_SSID
    string "Wi-Fi SSID"
    default ""

config SAEMS_WIFI_PASSWORD
    string "Wi-Fi password"
    default ""

config SAEMS_MQTT_BROKER_URI
    string "MQTT broker URI"
    default "mqtt://192.168.1.4:1883"

config SAEMS_MQTT_USERNAME
    string "MQTT username"
    default "saems_esp32"

config SAEMS_MQTT_PASSWORD
    string "MQTT password"
    default ""

config SAEMS_DEVICE_ID
    string "Device ID"
    default "farm-01"

config SAEMS_TELEMETRY_INTERVAL_SECONDS
    int "Telemetry interval in seconds"
    range 1 3600
    default 10

config SAEMS_BLE_ENABLED
    bool "Enable BLE direct connection"
    default y
    help
        Exposes the SAEMS GATT service used by the mobile application for
        telemetry notifications, configuration and pump commands.

config SAEMS_AP_ENABLED
    bool "Enable Wi-Fi Access Point and local REST API"
    default n
    help
        Enables AP+STA mode and the local API at http://192.168.4.1. Keep this
        disabled until a unique WPA2 password has been configured.

config SAEMS_AP_PASSWORD
    string "Wi-Fi AP password"
    default ""
    help
        WPA2 password for the direct connection AP. It must contain at least
        eight characters and must not be committed in sdkconfig.

config SAEMS_POWER_SAVE_ENABLED
    bool "Enable Wi-Fi modem saving in Direct mode"
    default y
    help
        Legacy/runtime switch for Direct mode only. Light and Battery are
        selected by the power_mode value stored in NVS.

choice SAEMS_POWER_MODE
    prompt "Default power mode for unprovisioned NVS"
    default SAEMS_POWER_MODE_MODEM_SAVE
    help
        All three modes are compiled into one firmware. This choice is used only
        until power_mode is saved in NVS. BLE or Wi-Fi AP can change the mode at
        runtime and firmware applies it at the next sampling boundary.

config SAEMS_POWER_MODE_ACTIVE
    bool "Always active"

config SAEMS_POWER_MODE_MODEM_SAVE
    bool "Direct mode: Wi-Fi modem power save"

config SAEMS_POWER_MODE_LIGHT_SLEEP
    bool "Automatic Light Sleep"

config SAEMS_POWER_MODE_DEEP_SLEEP
    bool "Battery mode: timer Deep Sleep"

endchoice

config SAEMS_DEEP_SLEEP_SYNC_WINDOW_SECONDS
    int "Maximum MQTT synchronization window before Deep Sleep"
    range 1 120
    default 15
    help
        Maximum awake time used to connect and drain queued telemetry. When the
        deadline expires, pending records remain in NVS and the device sleeps;
        the next wake cycle retries them instead of staying awake indefinitely.

config SAEMS_BATTERY_MAINTENANCE_WINDOW_SECONDS
    int "Minimum BLE/AP maintenance window in Battery mode"
    range 1 60
    default 10
    help
        Minimum awake time after each sample. BLE/AP remain available during
        this window so the mobile app can change power_mode without reflashing.
        A connected BLE session postpones Deep Sleep until it disconnects.

choice SAEMS_BH1750_I2C_ADDRESS
    prompt "BH1750 I2C address"
    default SAEMS_BH1750_ADDRESS_LOW

config SAEMS_BH1750_ADDRESS_LOW
    bool "0x23 (ADDR low or floating)"

config SAEMS_BH1750_ADDRESS_HIGH
    bool "0x5C (ADDR high)"

endchoice

config SAEMS_RELAY_ACTIVE_LOW
    bool "Relay inputs are active-low"
    default y
    help
        Most two-channel SRD-05VDC-SL-C relay modules energize a channel
        when IN is low. Disable this option only if the actual relay board
        is confirmed to use active-high inputs.

config SAEMS_RELAY_MAX_ON_SECONDS
    int "Maximum pump ON duration in seconds"
    range 1 86400
    default 60
    help
        Safety limit for remote pump commands. The firmware turns channel 1
        off automatically after this duration.

config SAEMS_SOIL_SENSOR_ENABLED
    bool "Enable LM393 soil moisture sensor"
    default n
    help
        Enable only after attaching the probe. Percentage output also needs
        measured endpoints and soil_calibrated=true in the device config.

config SAEMS_SOIL_RAW_READOUT_ENABLED
    bool "Read LM393 raw ADC for calibration even when soil is disabled in NVS"
    default n
    help
        Use only with the probe attached and VCC=3.3V. Reads AO/DO without
        inventing a moisture percentage. Useful when an older NVS config
        still has soil_enabled=false. Keep disabled with an open ADC input.

config SAEMS_SOIL_DRY_RAW
    int "LM393 dry ADC value"
    range 0 4095
    default 3000
    depends on SAEMS_SOIL_SENSOR_ENABLED

config SAEMS_SOIL_WET_RAW
    int "LM393 wet ADC value"
    range 0 4095
    default 1200
    depends on SAEMS_SOIL_SENSOR_ENABLED

config SAEMS_PUMP_SIMULATED
    bool "Pump is simulated (no pump or pump supply attached)"
    default y
    help
        Automatic watering and pump commands still switch relay channel 1
        and report pump_state/pump_reason, but the log marks every run as
        simulated. Disable once a real pump and its supply are wired.

choice SAEMS_BATTERY_SOURCE
    prompt "Battery level source"
    default SAEMS_BATTERY_SOURCE_NONE
    help
        none: USB powered, battery_pct is null.
        adc: 1S LiPo through a resistor divider on an ADC1 pin.
        simulated: demo level that drains each sample; set it with the
        {"command":"battery_sim","pct":N} command over BLE/AP/MQTT.

config SAEMS_BATTERY_SOURCE_NONE
    bool "None (USB powered)"

config SAEMS_BATTERY_SOURCE_ADC
    bool "ADC with resistor divider"

config SAEMS_BATTERY_SOURCE_SIMULATED
    bool "Simulated"

endchoice

config SAEMS_BATTERY_ADC_GPIO
    int "Battery divider ADC GPIO (ADC1 only)"
    range 1 10
    default 6
    depends on SAEMS_BATTERY_SOURCE_ADC
    help
        GPIO6 is ADC1_CH5 on ESP32-S3. ADC2 cannot be used while Wi-Fi runs.

config SAEMS_BATTERY_DIVIDER_X100
    int "Divider ratio x100 (battery voltage / pin voltage)"
    range 100 1000
    default 200
    depends on SAEMS_BATTERY_SOURCE_ADC
    help
        200 for two equal resistors (e.g. 100k/100k), which keeps 4.2 V
        at 2.1 V on the pin, inside the 12 dB attenuation range.

config SAEMS_BATTERY_SIM_START_PCT
    int "Simulated battery level after power-on (%)"
    range 0 100
    default 80
    depends on SAEMS_BATTERY_SOURCE_SIMULATED

config SAEMS_BATTERY_SIM_DRAIN_X10
    int "Simulated drain per sample (tenths of a percent)"
    range 0 100
    default 5
    depends on SAEMS_BATTERY_SOURCE_SIMULATED

config SAEMS_BATTERY_LOW_PCT
    int "Low battery level (%)"
    range 5 60
    default 20
    depends on !SAEMS_BATTERY_SOURCE_NONE
    help
        Below this level the device switches to Battery (Deep Sleep) mode
        and samples at least every SAEMS_BATTERY_LOW_INTERVAL_SECONDS.

config SAEMS_BATTERY_CRITICAL_PCT
    int "Critical battery level (%)"
    range 1 30
    default 5
    depends on !SAEMS_BATTERY_SOURCE_NONE
    help
        Below this level the pump is stopped and blocked, and the device
        sleeps for SAEMS_BATTERY_CRITICAL_INTERVAL_SECONDS between samples.

config SAEMS_BATTERY_LOW_INTERVAL_SECONDS
    int "Minimum sample interval on low battery (s)"
    range 10 3600
    default 600
    depends on !SAEMS_BATTERY_SOURCE_NONE

config SAEMS_BATTERY_CRITICAL_INTERVAL_SECONDS
    int "Sample interval on critical battery (s)"
    range 60 86400
    default 3600
    depends on !SAEMS_BATTERY_SOURCE_NONE

config SAEMS_STATUS_LED_ENABLED
    bool "Show device status on the onboard WS2812 RGB LED"
    default y
    help
        Green online, blinking yellow server unreachable, blue phone
        connected over BLE/AP, red sensor error, purple sending offline
        backlog, white booting, off before Deep Sleep.

config SAEMS_STATUS_LED_GPIO
    int "WS2812 data GPIO"
    range 0 48
    default 48
    depends on SAEMS_STATUS_LED_ENABLED
    help
        ESP32-S3-DevKitC-1 v1.0 uses GPIO48; v1.1 boards use GPIO38.

config SAEMS_STATUS_LED_BRIGHTNESS
    int "Status LED brightness (1-255)"
    range 1 255
    default 16
    depends on SAEMS_STATUS_LED_ENABLED

endmenu
```
